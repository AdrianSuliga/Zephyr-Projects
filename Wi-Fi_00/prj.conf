## CMakeLists.txt
```
cmake_minimum_required(VERSION 3.22)

find_package(Zephyr)
project(wi-fi-test)

target_sources(app PRIVATE src/main.c)
```

## prj.conf
```kconfig
CONFIG_NETWORKING=y

CONFIG_NET_DHCPV4=y
CONFIG_NET_IPV4=y
CONFIG_NET_IPV6=n
CONFIG_NET_TCP=y

CONFIG_WIFI=y
CONFIG_NET_SHELL=y
CONFIG_NET_L2_WIFI_SHELL=y

CONFIG_NET_L2_ETHERNET=y
CONFIG_ESP32_WIFI_STA_AUTO_DHCPV4=y

CONFIG_NET_MGMT_EVENT_QUEUE_TIMEOUT=5000
CONFIG_NET_MGMT_EVENT_QUEUE_SIZE=16
```

## src/main.c
```c
#include <zephyr/kernel.h>

int main()
{
    return 0;
}
```
