/ {
    zephyr,user {
        io-channels = <&adc1 0>;
    };
};

&adc1 {
    compatible = "espressif,esp32-adc";
    status = "okay";
    #address-cells = <1>;
    #size-cells = <0>;

    pot_channel: channel@0 {
        reg = <0>;
        zephyr,gain = "ADC_GAIN_1_4";
        zephyr,reference = "ADC_REF_INTERNAL";
        zephyr,acquisition-time = <ADC_ACQ_TIME_DEFAULT>;
        zephyr,resolution = <12>;
        zephyr,oversampling = <4>;
    };
};