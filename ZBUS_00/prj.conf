## CMakeLists.txt
```
cmake_minimum_required(VERSION 3.22)

find_package(Zephyr)
project(zbus-test)

file(GLOB SRC_FILES "src/*.c")
target_sources(app PRIVATE ${SRC_FILES})
```

## prj.conf
```kconfig
CONFIG_ZBUS=y
```

## src/thread1.c
```c
#include <zephyr/kernel.h>
#include <zephyr/zbus/zbus.h>
#include "zbus_local.h"

void listener_callback(const struct zbus_channel *chan) 
{
    const struct test_msg *msg;
    if (&test_channel == chan) {
        msg = zbus_chan_const_msg(chan);
        printk("From listener -> %d %d %d\n", msg->x, msg->y, msg->z);
    }
}

ZBUS_LISTENER_DEFINE(my_listener, listener_callback);

void thread_entry1(void) 
{
    while (1) {
        printk("Thread 1 running...\n");
        k_sleep(K_SECONDS(1));
    }
}
K_THREAD_DEFINE(thread1, 1024, thread_entry1, NULL, NULL, NULL, 3, 0, 0);
```

## src/thread2.c
```c
#include <zephyr/kernel.h>
#include <zephyr/zbus/zbus.h>
#include "zbus_local.h"

void thread_entry2(void)
{
    while (1) {
        printk("Thread 2 running...\n");
        printk("Publishing to channel...\n");
        const struct test_msg msg = {
            .x = 2,
            .y = 1,
            .z = 3
        };
        zbus_chan_pub(&test_channel, &msg, K_FOREVER);
        k_sleep(K_SECONDS(1));
    }
}
K_THREAD_DEFINE(thread2, 1024, thread_entry2, NULL, NULL, NULL, 3, 0, 0);
```

## src/zbus_local.c
```c
#include "zbus_local.h"

ZBUS_CHAN_DEFINE(test_channel,
                struct test_msg,
                NULL,
                NULL,
                ZBUS_OBSERVERS(my_listener),
                ZBUS_MSG_INIT(.x = 0, .y = 0, .z = 0)
);
```

## src/zbus_local.h
```c
#include <zephyr/zbus/zbus.h>

struct test_msg {
    int x;
    int y;
    int z;
};

ZBUS_CHAN_DECLARE(test_channel);
```
